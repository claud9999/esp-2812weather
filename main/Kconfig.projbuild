## main/Kconfig.projbuild
```kconfig
menu "Project Configuration"

    config BROKER_URL
        string "Broker URL"
        default "mqtt://mqtt.lan"
        help
            URL of the broker to connect to

    config MQTT_CMD_BASE
        string "MQTT Command topic base"
        default "cmd/led_string"
        help
            The base path for command topics.

    config MQTT_TLM_BASE
        string "Telemetry topic base"
        default "tlm/led_string"
        help
            The base path for telemetry topics.

    config MQTT_HEARTBEAT_SEC
        int "seconds between heartbeat"
        default 10
        help
            Heartbeats will be published every N seconds.

    config BLINK_GPIO
        int "Blink GPIO number"
        range 0 34
        default 2
        help
            GPIO number (IOxx) to blink on and off.

            Some GPIOs are used for other purposes (flash connections, etc.) and cannot be used to blink.

            GPIOs 35-39 are input-only so cannot be used as outputs.

    config WIFI_SSID
        string "WiFi SSID"
        default "hotcat"
        help
            SSID (network name) for the example to connect to.

    config WIFI_PASSWORD
        string "WiFi Password"
        default "mypassword"
        help
            WiFi password (WPA or WPA2) for the example to use.

    config LED_STRIP_GPIO
        int "The GPIO for controlling the LED strip"
        default 5
        help
            Set the GPIO number used for controlling the LED strip.

    config LED_STRIP_COUNT
        int "Number of LEDS in the strip"
        default 300
        help
            A single RGB strip contains several LEDs.
endmenu
```
